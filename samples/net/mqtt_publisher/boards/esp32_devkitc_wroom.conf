## samples/net/mqtt_publisher/boards/esp32_devkitc_wroom.conf
```kconfig
# # CONFIG_SIZE_OPTIMIZATIONS=y
# CONFIG_DEBUG_OPTIMIZATIONS=y

# CONFIG_CONSOLE=y
# CONFIG_SERIAL=y
# CONFIG_UART_CONSOLE=y

# CONFIG_GPIO=y
# CONFIG_UART_INTERRUPT_DRIVEN=y
# CONFIG_ETH_ESP32=y
# CONFIG_GPIO_PCF857X=y
# CONFIG_SDHC=y
# CONFIG_MMC_STACK=y

# # CONFIG_KERNEL_INIT_PRIORITY_DEFAULT == 40
# CONFIG_SPI_INIT_PRIORITY=40
# CONFIG_SDHC_INIT_PRIORITY=41
# CONFIG_SD_INIT_PRIORITY=42
# CONFIG_FILE_SYSTEM_INIT_PRIORITY=43
# CONFIG_STORAGE_PREINIT_PRIORITY=44

# # +----------------------+
# # | Bootloader           |
# # +----------------------+

# CONFIG_BOOTLOADER_MCUBOOT=y
# CONFIG_FLASH_MAP=y
# CONFIG_STREAM_FLASH=y
# CONFIG_IMG_MANAGER=y
# # CONFIG_IMG_ENABLE_IMAGE_CHECK=y
# CONFIG_MCUBOOT_IMG_MANAGER=y
# CONFIG_IMG_BLOCK_BUF_SIZE=512
# # CONFIG_BASE64=y
# CONFIG_MCUBOOT_BOOTLOADER_MODE_SWAP_SCRATCH=y

# # +----------------------------------------------+
# # | Memory settings are speciffic to the target  |
# # +----------------------------------------------+

# # TODO decrease these numbers!
# CONFIG_ISR_STACK_SIZE=8192
# CONFIG_IDLE_STACK_SIZE=8192
# CONFIG_MAIN_STACK_SIZE=32768
# # CONFIG_SHELL_STACK_SIZE=8192
# # CONFIG_LV_SPAN_SNIPPET_STACK_SIZE=8192
# CONFIG_SYSTEM_WORKQUEUE_STACK_SIZE=8192

# # This one originally was ~48k and this one is placed in dram0_1_seg. Consider disabling.
# CONFIG_ESP_HEAP_MEM_POOL_REGION_1_SIZE=8192
# # This one lands in dram0_0_seg
# CONFIG_HEAP_MEM_POOL_SIZE=65536

# # This was iuncreased on purpose
# CONFIG_ETH_ESP32_RX_THREAD_STACK_SIZE=2048
# CONFIG_NET_RX_STACK_SIZE=2048
# CONFIG_NET_TCP_WORKQ_STACK_SIZE=2048
# CONFIG_NET_TX_STACK_SIZE=2048

# # +----------------------+
# # | Test settings        |
# # +----------------------+

CONFIG_NET_CONFIG_MY_IPV4_ADDR="192.168.0.223"
CONFIG_NET_CONFIG_PEER_IPV4_ADDR="192.168.0.205"
CONFIG_NET_CONFIG_MY_IPV4_GW="192.168.0.1"
CONFIG_NET_CONFIG_MY_IPV4_NETMASK="255.255.255.0"
CONFIG_DNS_SERVER1="192.168.0.1"
```
