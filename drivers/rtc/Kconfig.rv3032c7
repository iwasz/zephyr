## drivers/rtc/Kconfig.rv3032c7
```kconfig
# SPDX-License-Identifier: Apache-2.0
# Copyright (c) 2024 Łukasz Iwaszkiewicz
# Author: Łukasz Iwaszkiewicz <lukasz.iwaszkiewicz@gmail.com>

config RTC_RV3032C7
	bool "Micro Crystal RV-3032-C7 RTC driver"
	default y
	depends on DT_HAS_MICROCRYSTAL_RV3032C7_ENABLED
	select I2C
	help
	  Enable the Micro Crystal RV3032C7 RTC driver.

if RTC_RV3032C7

config RTC_RV3032C7_THREAD_STACK_SIZE
	int "Stack size for the rm3032c7 interrupt thread"
	default 512
	help
	  Size of the stack used for the thread handling interrupts and dispatching callbacks.

config RTC_RV3032C7_THREAD_PRIO
	int "Priority for the rm3032c7 interrupt thread"
	default 0
	help
	  Priority level for the thread handling interrupts and dispatching callbacks.

endif
```

## dts/bindings/rtc/microcrystal,rv3032c7.yaml
```yaml
# SPDX-License-Identifier: Apache-2.0
# Copyright (c) 2024 Łukasz Iwaszkiewicz
# Author: Łukasz Iwaszkiewicz <lukasz.iwaszkiewicz@gmail.com>

description: Micro Crystal RV-3032-C7 RTC

compatible: "microcrystal,rv3032c7"

include:
  - name: rtc-device.yaml
  - name: i2c-device.yaml

properties:
  reg:
    required: true

  int-gpios:
    type: phandle-array
    description: |
      GPIO connected to the RV3032C7 INT1 interrupt output. This signal is open-drain, active low.
```
